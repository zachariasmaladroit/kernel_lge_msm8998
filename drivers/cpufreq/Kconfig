## drivers/cpufreq/Kconfig
```kconfig
menu "CPU Frequency scaling"

config CPU_FREQ
	bool "CPU Frequency scaling"
	select SRCU
	help
	  CPU Frequency scaling allows you to change the clock speed of 
	  CPUs on the fly. This is a nice method to save power, because 
	  the lower the CPU clock speed, the less power the CPU consumes.

	  Note that this driver doesn't automatically change the CPU
	  clock speed, you need to either enable a dynamic cpufreq governor
	  (see below) after boot, or use a userspace tool.

	  For details, take a look at <file:Documentation/cpu-freq>.

	  If in doubt, say N.

if CPU_FREQ

config CPU_FREQ_GOV_COMMON
	bool

config CPU_FREQ_BOOST_SW
	bool
	depends on THERMAL

config CPU_FREQ_STAT
	tristate "CPU frequency translation statistics"
	default y
	help
	  This driver exports CPU frequency statistics information through sysfs
	  file system.

	  To compile this driver as a module, choose M here: the
	  module will be called cpufreq_stats.

	  If in doubt, say N.

config CPU_FREQ_STAT_DETAILS
	bool "CPU frequency translation statistics details"
	depends on CPU_FREQ_STAT
	help
	  This will show detail CPU frequency translation table in sysfs file
	  system.

	  If in doubt, say N.

choice
	prompt "Default CPUFreq governor"
	default CPU_FREQ_DEFAULT_GOV_USERSPACE if ARM_SA1100_CPUFREQ || ARM_SA1110_CPUFREQ
	default CPU_FREQ_DEFAULT_GOV_SCHEDUTIL
	help
	  This option sets which CPUFreq governor shall be loaded at
	  startup. If in doubt, select 'performance'.


config CPU_FREQ_DEFAULT_GOV_SCHED
	bool "sched"
	select CPU_FREQ_GOV_SCHED
	help
	  Use the CPUfreq governor 'sched' as default. This scales
	  cpu frequency using CPU utilization estimates from the
	  scheduler.

config CPU_FREQ_DEFAULT_GOV_SCHEDUTIL
	bool "schedutil"
	depends on SMP
	select CPU_FREQ_GOV_SCHEDUTIL
	select CPU_FREQ_GOV_PERFORMANCE
	help
	  Use the 'schedutil' CPUFreq governor by default. If unsure,
	  have a look at the help section of that governor. The fallback
	  governor will be 'performance'.

config CPU_FREQ_DEFAULT_GOV_SCHEDALUCARD
	bool "schedalucard"
	depends on SMP
	select CPU_FREQ_GOV_SCHEDALUCARD
	select CPU_FREQ_GOV_PERFORMANCE
	help
	  Use the 'schedalucard' CPUFreq governor by default. If unsure,
	  have a look at the help section of that governor. The fallback
	  governor will be 'performance'.

endchoice


config CPU_FREQ_GOV_SCHED
	bool "'sched' cpufreq governor"
	depends on CPU_FREQ
	depends on SMP
	select CPU_FREQ_GOV_COMMON
	help
	  'sched' - this governor scales cpu frequency from the
	  scheduler as a function of cpu capacity utilization. It does
	  not evaluate utilization on a periodic basis (as ondemand
	  does) but instead is event-driven by the scheduler.

	  If in doubt, say N.

config DSBOOST
	tristate "Dynamic SchedTune Boosting on events"
	depends on DYNAMIC_STUNE_BOOST
	help
	  This driver attempts to improve responsiveness on mobile devices
	  with Dynamic SchedTune Boosting support. Boosts are applied on
	  user input, after user input unboosts, and on a sched_boost trigger.

	  If in doubt, say N.

if DSBOOST

config INPUT_BOOST_DURATION
	int "Input boost duration"
	default "64"
	help
	  Default duration to boost on input.

config COOLDOWN_BOOST_DURATION
	int "Cooldown boost duration"
	default "3000"
	help
	  Default duration to boost after input boost finishes.

config INPUT_STUNE_BOOST
	int "Input SchedTune boost level"
	default "15"
	help
	  Default SchedTune boost level for the top-app cgroup.

	  A value of 0 disables SchedTune boosting for this level.

config COOLDOWN_STUNE_BOOST
	int "Cooldown SchedTune boost level"
	default "12"
	help
	  Default SchedTune boost level for the top-app cgroup after
	  input boosting finishes.

	  A value of 0 disables SchedTune boosting for this level.

endif

config CPU_FREQ_GOV_SCHEDUTIL
	bool "'schedutil' cpufreq policy governor"
	depends on CPU_FREQ && SMP
	select CPU_FREQ_GOV_ATTR_SET
	select IRQ_WORK
	help
	  This governor makes decisions based on the utilization data provided
	  by the scheduler.  It sets the CPU frequency to be proportional to
	  the utilization/capacity ratio coming from the scheduler.  If the
	  utilization is frequency-invariant, the new frequency is also
	  proportional to the maximum available frequency.  If that is not the
	  case, it is proportional to the current frequency of the CPU.  The
	  frequency tipping point is at utilization/capacity equal to 80% in
	  both cases.

	  If in doubt, say N.

config CPU_INPUT_BOOST
	bool "CPU Input Boost"
	help
	  Boosts the CPU on touchscreen and touchpad input, and allows for
	  boosting on other custom events, mainly which is intended to be for
	  boosting when there is a new frame ready to be rendered to the
	  display. The boost frequencies for this driver should be set so that
	  frame drops are near-zero at the boosted frequencies and power
	  consumption is minimized at said frequency combination.

if CPU_INPUT_BOOST

config INPUT_BOOST_DURATION_MS
	int "Input boost duration"
	default "100"
	help
	  Input boost duration in milliseconds.

config WAKE_BOOST_DURATION_MS
	int "Wake boost duration"
	default "1000"
	help
	  Wake boost duration in milliseconds.

config INPUT_BOOST_FREQ_LP
	int "Low-power cluster boost freq"
	default "0"
	help
	  Input boost frequency for the low-power CPU cluster.

config INPUT_BOOST_FREQ_PERF
	int "Performance cluster boost freq"
	default "0"
	help
	  Input boost frequency for the performance CPU cluster.

config INPUT_BOOST_GPU_FREQ
	int "GPU freq for boost CPU"
	default "0"
	help
	  GPU frequency for boost CPU.

config REMOVE_INPUT_BOOST_FREQ_LP
	int "Low-power cluster return frequency"
	default "0"
	help
	  This is the frequency the low-power cluster will fallback to
	  once the boost is over. The default 0 will make the policy
	  use cpuinfo.min_freq. In case the device has some kind of quirk
	  of using a higher than cpuinfo.min_freq (e.g. OnePlus 5/5T/6)
	  this frequency will be used.

config REMOVE_INPUT_BOOST_FREQ_PERF
	int "Performance cluster return frequency"
	default "0"
	help
	  This is the frequency the performance cluster will fallback to
	  once the boost is over. The default 0 will make the policy
	  use cpuinfo.min_freq. In case the device has some kind of quirk
	  of using a higher than cpuinfo.min_freq (e.g. OnePlus 5/5T/6)
	  this frequency will be used.

endif

comment "CPU frequency scaling drivers"

config CPU_BOOST
	tristate "Event base short term CPU freq boost"
	depends on CPU_FREQ
	help
	  This driver boosts the frequency of one or more CPUs based on
	  various events that might occur in the system. As of now, the
	  events it reacts to are:
	  - Migration of important threads from one CPU to another.

	  If in doubt, say N.

config CPU_FREQ_GOV_SCHEDALUCARD
	bool "'schedalucard' cpufreq policy governor"
	depends on CPU_FREQ && SMP
	select CPU_FREQ_GOV_ATTR_SET
	select IRQ_WORK
	help
	  This governor makes decisions based on the utilization data provided
	  by the scheduler.  It sets the CPU frequency to be proportional to
	  the utilization/capacity ratio coming from the scheduler. The
	  frequency tipping point is at utilization/capacity equal to 80%
	  by default.

	  If in doubt, say N.

comment "CPU frequency scaling drivers"

config CPUFREQ_DT
	tristate "Generic DT based cpufreq driver"
	depends on HAVE_CLK && OF
	# if CPU_THERMAL is on and THERMAL=m, CPUFREQ_DT cannot be =y:
	depends on !CPU_THERMAL || THERMAL
	select PM_OPP
	help
	  This adds a generic DT based cpufreq driver for frequency management.
	  It supports both uniprocessor (UP) and symmetric multiprocessor (SMP)
	  systems which share clock and voltage across all CPUs.

	  If in doubt, say N.

if X86
source "drivers/cpufreq/Kconfig.x86"
endif

if ARM || ARM64
source "drivers/cpufreq/Kconfig.arm"
endif

if PPC32 || PPC64
source "drivers/cpufreq/Kconfig.powerpc"
endif

if AVR32
config AVR32_AT32AP_CPUFREQ
	bool "CPU frequency driver for AT32AP"
	depends on PLATFORM_AT32AP
	default n
	help
	  This enables the CPU frequency driver for AT32AP processors.
	  If in doubt, say N.
endif

if IA64
config IA64_ACPI_CPUFREQ
	tristate "ACPI Processor P-States driver"
	depends on ACPI_PROCESSOR
	help
	This driver adds a CPUFreq driver which utilizes the ACPI
	Processor Performance States.

	For details, take a look at <file:Documentation/cpu-freq/>.

	If in doubt, say N.
endif

if MIPS
config LOONGSON2_CPUFREQ
	tristate "Loongson2 CPUFreq Driver"
	depends on LEMOTE_MACH2F
	help
	  This option adds a CPUFreq driver for loongson processors which
	  support software configurable cpu frequency.

	  Loongson2F and it's successors support this feature.

	  For details, take a look at <file:Documentation/cpu-freq/>.

	  If in doubt, say N.

config LOONGSON1_CPUFREQ
	tristate "Loongson1 CPUFreq Driver"
	depends on LOONGSON1_LS1B
	help
	  This option adds a CPUFreq driver for loongson1 processors which
	  support software configurable cpu frequency.

	  For details, take a look at <file:Documentation/cpu-freq/>.

	  If in doubt, say N.
endif

if SPARC64
config SPARC_US3_CPUFREQ
	tristate "UltraSPARC-III CPU Frequency driver"
	help
	  This adds the CPUFreq driver for UltraSPARC-III processors.

	  For details, take a look at <file:Documentation/cpu-freq>.

	  If in doubt, say N.

config SPARC_US2E_CPUFREQ
	tristate "UltraSPARC-IIe CPU Frequency driver"
	help
	  This adds the CPUFreq driver for UltraSPARC-IIe processors.

	  For details, take a look at <file:Documentation/cpu-freq>.

	  If in doubt, say N.
endif

if SUPERH
config SH_CPU_FREQ
	tristate "SuperH CPU Frequency driver"
	help
	  This adds the cpufreq driver for SuperH. Any CPU that supports
	  clock rate rounding through the clock framework can use this
	  driver. While it will make the kernel slightly larger, this is
	  harmless for CPUs that don't support rate rounding. The driver
	  will also generate a notice in the boot log before disabling
	  itself if the CPU in question is not capable of rate rounding.

	  For details, take a look at <file:Documentation/cpu-freq>.

	  If unsure, say N.
endif

config QORIQ_CPUFREQ
	tristate "CPU frequency scaling driver for Freescale QorIQ SoCs"
	depends on OF && COMMON_CLK && (PPC_E500MC || ARM)
	select CLK_QORIQ
	help
	  This adds the CPUFreq driver support for Freescale QorIQ SoCs
	  which are capable of changing the CPU's frequency dynamically.

endif
endmenu
```

## drivers/power/supply/Kconfig
```kconfig
source "drivers/power/supply/qcom/Kconfig"
source "drivers/power/supply/lge/Kconfig"
```
